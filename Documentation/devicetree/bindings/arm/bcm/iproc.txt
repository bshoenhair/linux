## Documentation/devicetree/bindings/arm/bcm/iproc.txt
```
Broadcom iProc device tree bindings
------------------------------------

SoCs
-------------------------------------------

Boards with Cygnus SoCs shall have the following properties:

Required root node property:

compatible = "brcm,cygnus";
```

## Documentation/devicetree/bindings/arm/cygnus.txt
```
Broadcom Cygnus device tree bindings
------------------------------------

All Cygnus boards shall have the following properties:

Required root node property:
	- compatible = "brcm,cygnus";

Boards variants shall have the following additional properties:

Required root node property for the BCM911360_ENTPHN board:
	- compatible = "brcm,bcm911360_entphn";
```

## Documentation/devicetree/bindings/clock/clk-cygnus.txt
```
Broadcom Cygnus Clock Controller

This binding uses the common clock binding:
Documentation/devicetree/bindings/clock/clock-bindings.txt

The Cygnus clock controller manages several PLL's and their channels, found only
on the Cygnus chip. Clocks that are common to iProc can be found in the iProc
clock controller. The controllers are split into a parent-child relationship
where the parent is the PLL and the child controls the PLL's channels.

All PLL's are derived from a 25MHz oscillator. The PLL's controlled are the
GENPLL, LCPLL, the MIPI PLL. In addition, there are two clocks derived from
GENPLL channel 0, and three that are derived directly from the oscillator.

Required properties:
- compatible: Must be one of the following:
    "brcm,cygnus-lcpll-clk" - Controls LCPLL.
    "brcm,cygnus-lcpll-ch" -  Controls LCPLL (parent) channels
    "brcm,cygnus-genpll-clk" - Controls parent GENPLL
    "brcm,cygnus-genpll-ch" - Controls GENPLL (parent) channels
    "brcm,cygnus-mipipll-clk" - Controls MIPI PLL
    "brcm,cygnus-mipipll-ch" - Controls parent MIPI PLL (parent) channels
    "brcm,cygnus-osc-derived" - Controls oscillator (parent) derived channels
        not controlled by any PLL.
    "brcm,cygnus-pll-derived" - Controls clocks derived from GENPLL channel 0.
	  These clocks have hard wired internal dividers and their clock rates
	  scale according to the GENPLL channel.

- reg: First register is the base address of the PLL. Register 2 and 3 are
  required by some clocks. They are the top clock gating control used to
  enable/disable clocks (ch 1), and the CRMU PLL AON CONTROL register which
  powers on PLL/LDO's (ch 2).

- clocks: The input parent clock phandle for the clock. This is either a PLL,
  oscillator, or GENPLL channel 0.

- channel: The PLL channel that the clock belongs to. This is used for
  "brcm,cygnus-lcpll-ch", "brcm,cygnus-genpll-ch", "brcm,cygnus-mipipll-ch",
  "brcm,cygnus-osc-derived" only.

- div: Used by "brcm,cygnus-pll-derived" to define the hard coded internal
  divider value. Used by "brcm,cygnus-osc-derived" to specify the programmable
  divider.

- #clock-cells: From common clock binding; shall be set to 0.

Examples:

		osc: oscillator {
			#clock-cells = <0>;
			compatible = "fixed-clock";
			clock-frequency = <25000000>;
		};

		lcpll: lcpll@0301d02c {
			#clock-cells = <0>;
			compatible = "brcm,cygnus-lcpll-clk";
			reg = <0x0301d02c 0x1c>;
			clocks = <&osc>;
		};

		genpll: genpll@0301d000 {
			#clock-cells = <0>;
			compatible = "brcm,cygnus-genpll-clk";
			reg = <0x0301d000 0x2c>,
				  <0x180AA024 0x4>,
				  <0x0301C020 0x4>;
			clocks = <&osc>;
		};

		axi21_clk: genpll_ch0@0301d000 {
			#clock-cells = <0>;
			compatible = "brcm,cygnus-genpll-ch";
			reg = <0x0301d000 0x2c>;
			clocks = <&genpll>;
			channel = <0>;
		};

		pcie_clk: lcpll_ch0@0301d02c {
			compatible = "brcm,cygnus-lcpll-ch";
			reg = <0x0301d02c 0x1c>;
			#clock-cells = <0>;
			clocks = <&lcpll>;
			channel = <0>;
		};

		axi41_clk: axi41_clk {
			reg = <0x0301d000 0x2c>;
			#clock-cells = <0>;
			compatible = "brcm,cygnus-pll-derived";
			clocks = <&axi21_clk>;
			div = <2>;
		};

		keypad_clk: keypad_clk@0301D048 {
			compatible = "brcm,cygnus-osc-derived";
			reg = <0x0301D048 0x4>,
				  <0x180AA024 0x4>;
			#clock-cells = <0>;
			clocks = <&osc>;
			channel = <0>;
			div = <392>;
		};

		mipipll: mipipll@180a9800 {
			#clock-cells = <0>;
			compatible = "brcm,cygnus-mipipll-clk";
			reg = <0x180a9800 0x2c>,
				  top_clk_gating_ctrl: <0x180AA024 0x4>,
				  crmu_pll_aon_ctrl: <0x0301C020 0x4>;
			clocks = <&osc>;
		};

		lcd_clk: mipipll_ch1@180a9800 {
			#clock-cells = <0>;
			compatible = "brcm,cygnus-mipipll-ch";
			reg = <0x180a9800 0x2c>,
				  <0x180AA024 0x4>;
			clocks = <&mipipll>;
			channel = <1>;
		};
```

## Documentation/devicetree/bindings/clock/clk-iproc.txt
```
Broadcom iProc Clock Controller

This binding uses the common clock binding:
Documentation/devicetree/bindings/clock/clock-bindings.txt

The iProc clock controller manages clocks that are common to iProc chips.
The controllers are split into a parent-child relationship where the parent is
the PLL and the child controls the PLL's channels.

The only PLL controlled is the ARM PLL which is derived from a 25MHz crystal.

Required properties:
- compatible: Must be one of the following:
    "brcm,iproc-arm-a9pll" - Controls ARM PLL.
    "brcm,iproc-arm-ch" -  Controls ARM PLL (parent) channels

- reg: The base address of the PLL.

- clocks: The input parent clock phandle for the clock. This is either a PLL,
  or oscillator.

- channel: The PLL channel that the clock belongs to. This is used for
  "brcm,iproc-arm-ch" only.

- #clock-cells: From common clock binding; shall be set to 0.

Example:

	osc: oscillator {
		#clock-cells = <0>;
		compatible = "fixed-clock";
		clock-frequency = <25000000>;
	};

	a9pll: arm_clk@19000000 {
		compatible = "brcm,iproc-arm-a9pll";
		reg = <0x19000000 0x1000>;
		#clock-cells = <0>;
		clocks = <&osc>;
	};

	periph_clk: periph_clk@19000000 {
		compatible = "brcm,iproc-arm-ch";
		reg = <0x19000000 0x1000>;
		#clock-cells = <0>;
		clocks = <&a9pll>;
		channel = <3>;
	};
```

## arch/arm/configs/bcm_cygnus_defconfig
```kconfig
CONFIG_KERNEL_XZ=y
# CONFIG_SWAP is not set
CONFIG_SYSVIPC=y
CONFIG_IRQ_DOMAIN_DEBUG=y
CONFIG_HIGH_RES_TIMERS=y
CONFIG_BSD_PROCESS_ACCT=y
CONFIG_BSD_PROCESS_ACCT_V3=y
CONFIG_IKCONFIG=y
CONFIG_IKCONFIG_PROC=y
CONFIG_LOG_BUF_SHIFT=19
CONFIG_CGROUPS=y
CONFIG_CGROUP_FREEZER=y
CONFIG_CGROUP_DEVICE=y
CONFIG_CGROUP_CPUACCT=y
CONFIG_RESOURCE_COUNTERS=y
CONFIG_CGROUP_SCHED=y
CONFIG_BLK_CGROUP=y
CONFIG_NAMESPACES=y
CONFIG_BLK_DEV_INITRD=y
CONFIG_SYSCTL_SYSCALL=y
CONFIG_EMBEDDED=y
CONFIG_PERF_EVENTS=y
# CONFIG_COMPAT_BRK is not set
CONFIG_MODULES=y
CONFIG_MODULE_UNLOAD=y
# CONFIG_BLK_DEV_BSG is not set
CONFIG_PARTITION_ADVANCED=y
CONFIG_ARCH_BCM=y
CONFIG_ARCH_BCM_CYGNUS=y
CONFIG_ARM_THUMBEE=y
CONFIG_PREEMPT=y
CONFIG_AEABI=y
CONFIG_HIGHMEM=y
# CONFIG_COMPACTION is not set
# CONFIG_ATAGS is not set
CONFIG_ZBOOT_ROM_TEXT=0x0
CONFIG_ZBOOT_ROM_BSS=0x0
CONFIG_ARM_APPENDED_DTB=y
CONFIG_CPU_IDLE=y
CONFIG_VFP=y
CONFIG_NEON=y
# CONFIG_SUSPEND is not set
CONFIG_NET=y
CONFIG_PACKET=y
CONFIG_UNIX=y
CONFIG_INET=y
CONFIG_IP_MULTICAST=y
CONFIG_IP_ADVANCED_ROUTER=y
CONFIG_IP_MULTIPLE_TABLES=y
CONFIG_IP_ROUTE_MULTIPATH=y
CONFIG_IP_ROUTE_VERBOSE=y
CONFIG_IP_PNP=y
CONFIG_IP_PNP_DHCP=y
CONFIG_IP_MROUTE=y
CONFIG_IP_MROUTE_MULTIPLE_TABLES=y
CONFIG_SYN_COOKIES=y
# CONFIG_INET_XFRM_MODE_TRANSPORT is not set
# CONFIG_INET_XFRM_MODE_TUNNEL is not set
# CONFIG_INET_XFRM_MODE_BEET is not set
# CONFIG_INET_LRO is not set
# CONFIG_INET_DIAG is not set
CONFIG_TCP_CONG_ADVANCED=y
# CONFIG_TCP_CONG_BIC is not set
# CONFIG_TCP_CONG_WESTWOOD is not set
# CONFIG_TCP_CONG_HTCP is not set
CONFIG_IPV6=y
# CONFIG_INET6_XFRM_MODE_TRANSPORT is not set
# CONFIG_INET6_XFRM_MODE_TUNNEL is not set
# CONFIG_INET6_XFRM_MODE_BEET is not set
# CONFIG_IPV6_SIT is not set
CONFIG_IPV6_MULTIPLE_TABLES=y
CONFIG_IPV6_SUBTREES=y
CONFIG_IPV6_MROUTE=y
CONFIG_NETFILTER=y
# CONFIG_BRIDGE_NETFILTER is not set
CONFIG_NF_CONNTRACK=y
# CONFIG_NF_CONNTRACK_PROCFS is not set
CONFIG_NF_CONNTRACK_FTP=y
CONFIG_NF_CONNTRACK_IPV4=y
CONFIG_IP_NF_IPTABLES=y
CONFIG_IP_NF_FILTER=y
CONFIG_IP_NF_TARGET_REJECT=y
CONFIG_IP_NF_NAT=y
CONFIG_IP_NF_TARGET_MASQUERADE=y
CONFIG_IP_NF_TARGET_REDIRECT=y
CONFIG_IP_NF_MANGLE=y
CONFIG_IP_NF_RAW=y
CONFIG_NF_CONNTRACK_IPV6=y
CONFIG_IP6_NF_IPTABLES=y
CONFIG_IP6_NF_MATCH_AH=y
CONFIG_IP6_NF_MATCH_EUI64=y
CONFIG_IP6_NF_MATCH_FRAG=y
CONFIG_IP6_NF_MATCH_OPTS=y
CONFIG_IP6_NF_MATCH_IPV6HEADER=y
CONFIG_IP6_NF_MATCH_MH=y
CONFIG_IP6_NF_MATCH_RT=y
CONFIG_IP6_NF_FILTER=y
CONFIG_IP6_NF_TARGET_REJECT=y
CONFIG_IP6_NF_MANGLE=y
CONFIG_IP6_NF_RAW=y
CONFIG_BRIDGE=y
# CONFIG_BRIDGE_IGMP_SNOOPING is not set
CONFIG_VLAN_8021Q=y
CONFIG_NET_SCHED=y
CONFIG_NET_SCH_FQ_CODEL=y
CONFIG_DEVTMPFS=y
CONFIG_DEVTMPFS_MOUNT=y
# CONFIG_FIRMWARE_IN_KERNEL is not set
CONFIG_MTD=y
CONFIG_MTD_CMDLINE_PARTS=y
CONFIG_MTD_BLOCK=y
CONFIG_MTD_NAND=y
CONFIG_MTD_UBI=y
# CONFIG_BLK_DEV is not set
CONFIG_SCSI=y
CONFIG_BLK_DEV_SD=y
CONFIG_NETDEVICES=y
# CONFIG_NET_CADENCE is not set
# CONFIG_NET_VENDOR_CIRRUS is not set
# CONFIG_NET_VENDOR_FARADAY is not set
# CONFIG_NET_VENDOR_INTEL is not set
# CONFIG_NET_VENDOR_MARVELL is not set
# CONFIG_NET_VENDOR_MICREL is not set
# CONFIG_NET_VENDOR_NATSEMI is not set
# CONFIG_NET_VENDOR_SEEQ is not set
# CONFIG_NET_VENDOR_SMSC is not set
# CONFIG_NET_VENDOR_STMICRO is not set
# CONFIG_NET_VENDOR_WIZNET is not set
CONFIG_PHYLIB=y
CONFIG_BROADCOM_PHY=y
# CONFIG_INPUT_MOUSEDEV is not set
# CONFIG_KEYBOARD_ATKBD is not set
# CONFIG_INPUT_MOUSE is not set
# CONFIG_SERIO is not set
# CONFIG_LEGACY_PTYS is not set
CONFIG_SERIAL_8250=y
# CONFIG_SERIAL_8250_DEPRECATED_OPTIONS is not set
CONFIG_SERIAL_8250_CONSOLE=y
CONFIG_SERIAL_8250_NR_UARTS=2
CONFIG_SERIAL_8250_RUNTIME_UARTS=2
CONFIG_SERIAL_8250_DW=y
CONFIG_SERIAL_OF_PLATFORM=y
# CONFIG_HW_RANDOM is not set
CONFIG_I2C=y
CONFIG_I2C_CHARDEV=y
# CONFIG_I2C_HELPER_AUTO is not set
CONFIG_I2C_SMBUS=y
CONFIG_SPI=y
CONFIG_SPI_PL022=y
CONFIG_SPI_SPIDEV=y
CONFIG_GPIO_SYSFS=y
# CONFIG_HWMON is not set
CONFIG_WATCHDOG=y
CONFIG_ARM_SP805_WATCHDOG=y
CONFIG_FB=y
CONFIG_FB_ARMCLCD=y
CONFIG_BACKLIGHT_LCD_SUPPORT=y
# CONFIG_LCD_CLASS_DEVICE is not set
CONFIG_BACKLIGHT_CLASS_DEVICE=y
# CONFIG_BACKLIGHT_GENERIC is not set
CONFIG_BACKLIGHT_PWM=y
CONFIG_SOUND=y
CONFIG_SND=y
CONFIG_SND_DYNAMIC_MINORS=y
CONFIG_SND_VERBOSE_PRINTK=y
CONFIG_SND_DEBUG=y
CONFIG_SND_USB_AUDIO=y
CONFIG_SND_SOC=y
CONFIG_USB=y
CONFIG_USB_ANNOUNCE_NEW_DEVICES=y
CONFIG_USB_EHCI_HCD=y
CONFIG_USB_EHCI_ROOT_HUB_TT=y
CONFIG_USB_EHCI_HCD_PLATFORM=y
CONFIG_USB_STORAGE=y
CONFIG_MMC=y
CONFIG_MMC_SDHCI=y
CONFIG_MMC_SDHCI_PLTFM=y
CONFIG_PWM=y
CONFIG_EXT4_FS=y
CONFIG_MSDOS_FS=y
CONFIG_VFAT_FS=y
CONFIG_NTFS_FS=y
CONFIG_TMPFS=y
CONFIG_TMPFS_POSIX_ACL=y
CONFIG_UBIFS_FS=y
CONFIG_NFS_FS=y
CONFIG_ROOT_NFS=y
CONFIG_NLS_CODEPAGE_437=y
CONFIG_NLS_ISO8859_1=y
CONFIG_NLS_UTF8=y
CONFIG_DYNAMIC_DEBUG=y
CONFIG_DEBUG_INFO=y
CONFIG_DEBUG_INFO_REDUCED=y
CONFIG_STRIP_ASM_SYMS=y
CONFIG_DEBUG_FS=y
CONFIG_MAGIC_SYSRQ=y
CONFIG_DEBUG_OBJECTS=y
CONFIG_DEBUG_OBJECTS_RCU_HEAD=y
CONFIG_SLUB_DEBUG_ON=y
CONFIG_DEBUG_MEMORY_INIT=y
CONFIG_DEBUG_SHIRQ=y
CONFIG_DETECT_HUNG_TASK=y
CONFIG_DEFAULT_HUNG_TASK_TIMEOUT=110
CONFIG_BOOTPARAM_HUNG_TASK_PANIC=y
# CONFIG_SCHED_DEBUG is not set
CONFIG_SCHEDSTATS=y
CONFIG_DEBUG_RT_MUTEXES=y
CONFIG_PROVE_LOCKING=y
CONFIG_DEBUG_ATOMIC_SLEEP=y
# CONFIG_DEBUG_BUGVERBOSE is not set
CONFIG_DEBUG_SG=y
CONFIG_DEBUG_NOTIFIERS=y
CONFIG_DEBUG_CREDENTIALS=y
CONFIG_PROVE_RCU=y
CONFIG_DEBUG_USER=y
CONFIG_DEBUG_LL=y
CONFIG_DEBUG_LL_UART_8250=y
CONFIG_DEBUG_UART_PHYS=0x18023000
CONFIG_DEBUG_UART_VIRT=0xf1023000
CONFIG_EARLY_PRINTK=y
# CONFIG_CRYPTO_ANSI_CPRNG is not set
```
